## components/esp-openclaw-room-node/Kconfig
```kconfig
menu "OpenClaw room node"

config OPENCLAW_ROOM_HEAP_CENSUS_REGION_DUMP
    bool "Heap census: verbose per-region dump"
    default n
    help
        Enables heap_caps_print_heap_info in room_heap_census_log. The one-line
        census summaries and block counts always print; this adds the multi-line
        IDF per-region dump. Heavy: contributed to a Tmr Svc stack overflow under
        heap pressure (2026-10-21). Enable only for targeted captures.

config OPENCLAW_ROOM_WIFI_SSID
    string "Wi-Fi SSID"
    default ""

config OPENCLAW_ROOM_WIFI_PASSWORD
    string "Wi-Fi password"
    default ""

config OPENCLAW_ROOM_SETUP_CODE
    string "Voice-node setup code"
    default ""

config OPENCLAW_ROOM_GATEWAY_HTTP_BASE_URL
    string "Optional Gateway HTTP origin override"
    default ""
    help
        HTTP(S) origin used by Canvas and Talk. Leave empty to derive it from
        the authoritative active/saved ws(s) Gateway URI.

config OPENCLAW_ROOM_TALK_PROVIDER
    string "Optional Talk provider override"
    default ""

config OPENCLAW_ROOM_TALK_MODEL
    string "Optional Talk model override"
    default ""

config OPENCLAW_ROOM_TALK_VOICE
    string "Optional Talk voice override"
    default ""

config OPENCLAW_ROOM_VOICE_ACTIONS
    bool "Request owner access for voice agent actions"
    default n
    help
        Request operator.write and operator.admin in addition to read/talk.
        The Gateway must separately approve owner access. This permits the
        configured agent's owner-only tools, including control of other nodes
        and Gateway administration; access is not limited to one device.
        Prepare a credential with the USB voice-actions commands before
        enabling and flashing this setting. Leave disabled for read-only voice
        access.

config OPENCLAW_ROOM_CALL_IDLE_SECONDS
    int "Maximum call lifetime in seconds"
    range 15 1800
    default 180

endmenu
```
